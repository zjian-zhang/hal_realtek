## ameba/Kconfig
```kconfig
# Copyright (c) 2024 Realtek Semiconductor Corp.
# SPDX-License-Identifier: Apache-2.0

if SOC_FAMILY_REALTEK_AMEBA

config REALTEK_AMEBA_HAL_LIB
	bool "RealTek Ameba HAL library"
	help
	  This option enables the Realtek Ameba HAL library.

config ARM_CORE_CM4
	bool
	default y if SOC_AMEBAD

endif # SOC_FAMILY_REALTEK_AMEBA
```
